## drivers/net/wireless/realtek/rtl8192eu/Kconfig
```kconfig
config RTL8192EU
	tristate "Realtek 8192EU USB WiFi"
	depends on MAC80211 && USB
	select CFG80211_WEXT
	select WIRELESS_EXT
	select WEXT_PRIV
	---help---
	  This option adds the Realtek RTL8192EU USB device such as TP-LINK TL-WN823N V2.
```
